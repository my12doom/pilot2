#include <string.h>

#include <stdint.h>
#include <HAL/Interface/II2C.h>
#include <HAL/STM32F4/F4GPIO.h>

using namespace STM32F4;
using namespace HAL;
	
uint8_t edit[256];
uint8_t eepromdat[256] = {0x00, 0xFF, 0xFF, 0xFF, 0xFF, 0xFF, 0xFF, 0x00, 0x10, 0xAC, 0xA3, 0xA0, 0x4C,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 0x00, };


int r = 0;
void read_edid()
{
	F4GPIO SCL(GPIOB, GPIO_Pin_6);
	F4GPIO SDA(GPIOB, GPIO_Pin_7);
	I2C_SW i2c(&SCL, &SDA);
	
	i2c.set_speed(200);
	for(int i=0; i<256; i++)
	{
		//r = i2c.write_reg(0xA0, i, eepromdat[i]);
		//systimer->delayms(10);
		r = i2c.read_reg(0xA0, i, &edit[i]);
	}
	
	r = memcmp(eepromdat, edit, sizeof(edit));
	
	return;
}

unsigned char adv7611_script[] = {
	0x98, 0xF4, 0x80,
	0x98, 0xF5, 0x7C,
	0x98, 0xF8, 0x4C,
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	0x34, 0x12, 0x01,
	0xFF };


int main()
{
	F4GPIO SCL(GPIOB, GPIO_Pin_2);
	F4GPIO SDA(GPIOB, GPIO_Pin_1);
	I2C_SW i2c_adv7611(&SCL, &SDA);
	i2c_adv7611.set_speed(20);
	
	/*
	uint8_t cec_i2c = 0x80;				// 0xf4
	uint8_t info_i2c = 0x7c;			// 0xf5
	
	uint8_t repteater_i2c = 0x64;
	uint8_t edid_ram_i2c = 0x6c;
	uint8_t hdmi_i2c = 0x68;
	uint8_t cp_i2c = 0x68;
	
	i2c.write_reg(0x98, 0xfa, edid_ram_i2c);
	i2c.write_reg(0x98, 0xf9, repteater_i2c);
	
	
	i2c.write_reg(repteater_i2c, 0x74, 1);		// disable EDID readout on DDC.
	
	for(int i=0; i<256; i++)
		r = i2c.write_reg(0x9a, i, eepromdat[i]);		
	
	i2c.write_reg(repteater_i2c, 0x74, 1);		// enable EDID readout on DDC.
	*/
	
	// reset ADV7611
	r = i2c_adv7611.write_reg(0x98, 0xFF, 0x80);		
	systimer->delayms(1);
	
	// program ADV7611 script
	for(int i=0; i<sizeof(adv7611_script); i+=3)
	{
		if (adv7611_script[i] == 0xff)
			break;
		
		r = i2c_adv7611.write_reg(adv7611_script[i], adv7611_script[i+1], adv7611_script[i+2]);
	}
	
	// program EDID
	r = i2c_adv7611.write_reg(0x68, 0x6C, 0xA3); // enable manual HPA
	r = i2c_adv7611.write_reg(0x98, 0x20, 0x70); // HPD low
	r = i2c_adv7611.write_reg(0x64, 0x74, 0x00); // disable internal EDID
	
	for(int i=0; i<256; i++)
		r = i2c_adv7611.write_reg(0x6C, i, eepromdat[i]);
	
	systimer->delayms(100);
	
	r = i2c_adv7611.write_reg(0x64, 0x74, 0x01); // enable internal EDID
	r = i2c_adv7611.write_reg(0x98, 0x20, 0xF0); // HPD high
	r = i2c_adv7611.write_reg(0x68, 0x6C, 0xA3); // disable manual HPA
	
	
	while(1)
	{
	}

}
